## build/conf/bblayers.conf
```bitbake
# LAYER_CONF_VERSION is increased each time build/conf/bblayers.conf
# changes incompatibly
LCONF_VERSION = "6"

BBPATH = "${TOPDIR}"
BBFILES ?= ""

BBLAYERS ?= " \
  /x/poky1/meta \
  /x/poky1/meta-yocto \
  /x/poky1/meta-yocto-bsp \
  /x/poky1/meta-v2x \
  "
BBLAYERS_NON_REMOVABLE ?= " \
  /x/poky1/meta \
  /x/poky1/meta-yocto \
  "
```
